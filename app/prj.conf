## prj.conf
```kconfig
CONFIG_BT=y
CONFIG_BT_PERIPHERAL=y
CONFIG_BT_DIS=y
CONFIG_BT_DIS_PNP=n
CONFIG_BT_DEVICE_NAME="LY10ZEPH"
CONFIG_STDOUT_CONSOLE=y
CONFIG_SERIAL=n
CONFIG_I2C=y
CONFIG_SENSOR=y
CONFIG_SHT3XD=y
CONFIG_GPIO=y
CONFIG_PWM=y
CONFIG_PWM_NRF5_SW=n
CONFIG_PWM_NRFX=y
CONFIG_CLOCK_CONTROL_NRF_K32SRC_RC=y
CONFIG_CLOCK_CONTROL_NRF_K32SRC_250PPM=y
CONFIG_SYS_CLOCK_TICKS_PER_SEC=250
CONFIG_SPI=y
CONFIG_NRFX_SPI=y
CONFIG_LED_STRIP=y
CONFIG_APA102_STRIP=y
CONFIG_SHELL=n
```

## src/main.c
```c
// SPDX-License-Identifier: Apache-2.0

//
// Copyright (c) 2019-2021 Blue Clover Devices
//

/* main.c - Application main entry point */

#include <stdio.h>
#include <zephyr.h>

#include "app_ble.h"
#include "app_buzzer.h"
#include "app_ledstrip.h"
#include "app_sensor.h"

#define DELAY_TIME K_MSEC(100)

void main(void)
{
	int err;

	/* Bluetooth */
	err =  app_ble();
	if (err) {
		return;
	}

	/* LED strip control */
	err =  app_ledstrip_setup();
	if (err) {
		return;
	}

	err = app_buzzer_setup();
	if (err) {
		return;
	}

	while (1) {
		err =  app_ledstrip_run();
		if (err) {
			return;
		}
		k_sleep(DELAY_TIME);
	}

}
```

## src/app_ledstrip.c
```c
// SPDX-License-Identifier: Apache-2.0

//
// Copyright (c) 2019-2021 Blue Clover Devices
//

/* ledstrip.c - Application LED strip control */

#include <string.h>
#include <sys/printk.h>
#include <drivers/led_strip.h>
#include <drivers/gpio.h>

#include "app_ledstrip.h"

#define GPIO_OUT_DRV_NAME "GPIO_0"
#define GPIO_PWR_EN  25
#define STRIP_NUM_LEDS 4

static const struct device *strip;
static size_t ledstrip_counter;

static const struct led_rgb colors[] = {
	{ .r = 0x04, .g = 0x00, .b = 0x00, },   /* red 4 */
	{ .r = 0x02, .g = 0x00, .b = 0x00, },   /* red 2 */
	{ .r = 0x01, .g = 0x00, .b = 0x00, },   /* red 1 */
};

static const struct led_rgb black = {
	.r = 0x00,
	.g = 0x00,
	.b = 0x00,
};

struct led_rgb strip_colors[STRIP_NUM_LEDS];

const struct led_rgb *color_at(size_t time, size_t i)
{
	size_t rgb_start = time % STRIP_NUM_LEDS;

	if (rgb_start <= i && i < rgb_start + ARRAY_SIZE(colors)) {
		return &colors[i - rgb_start];
	} else {
		return &black;
	}
}

int app_ledstrip_setup(void)
{
	const struct device *gpio_out_dev;
	int ret;

	gpio_out_dev = device_get_binding(GPIO_OUT_DRV_NAME);
	if (!gpio_out_dev) {
		printk("Cannot find %s!\n", GPIO_OUT_DRV_NAME);
		return -1;
	}

	/* GPIO output */
	ret = gpio_pin_configure(gpio_out_dev, GPIO_PWR_EN, GPIO_OUTPUT);
	if (ret) {
		printk("Error configuring GPIO (err %d)\n", ret);
		return ret;
	}
	printk("Turning on 5V_LED Rail %d\n", GPIO_PWR_EN);

	ret = gpio_pin_set(gpio_out_dev, GPIO_PWR_EN, 1);
	if (ret) {
		printk("Error writing GPIO (err %d)\n", ret);
		return ret;
	}

	/* APA102 Strip */
	strip = device_get_binding(DT_LABEL(DT_INST(0, apa_apa102)));

	if (!strip) {
		printk("Cannot find %s!\n", GPIO_OUT_DRV_NAME);
		return -1;
	}

	ledstrip_counter = 0;

	return 0;
}

int app_ledstrip_run(void)
{
	size_t i;

	for (i = 0; i < STRIP_NUM_LEDS; i++) {
		memcpy(&strip_colors[i], color_at(ledstrip_counter, i),
		       sizeof(strip_colors[i]));
	}
	led_strip_update_rgb(strip, strip_colors, STRIP_NUM_LEDS);
	ledstrip_counter++;
	return 0;
}
```

## src/app_sensor.c
```c
// SPDX-License-Identifier: Apache-2.0

//
// Copyright (c) 2019-2021 Blue Clover Devices
//

/* app_sensor.c - Sensor interface */

#include <stdio.h>
#include <zephyr.h>
#include <device.h>
#include <drivers/sensor.h>

#include "app_sensor.h"

int app_sensor_evironmental_setup(void)
{
	struct sensor_value temp, hum;
	const struct device *dev = device_get_binding("SHT3XD");
	int rc;

	if (dev == NULL) {
		printf("Could not get SHT3XD device\n");
		return -1;
	}

	rc = sensor_sample_fetch(dev);
	if (rc == 0) {
		rc = sensor_channel_get(dev, SENSOR_CHAN_AMBIENT_TEMP, &temp);
	}
	if (rc == 0) {
		rc = sensor_channel_get(dev, SENSOR_CHAN_HUMIDITY, &hum);
	}
	if (rc != 0) {
		printf("SHT3XD: failed: %d\n", rc);
		return -1;
	}
	printf("[Sensor:OK]\n");
	printf("SHT3XD: %.2f Cel ; %0.2f %%RH\n",
	       sensor_value_to_double(&temp), sensor_value_to_double(&hum));
	return 0;
}

int app_sensor_motion_setup(void)
{
	int rc;
	struct sensor_value acc[3], gyr[3];
	const struct device *dev = device_get_binding("BMI270");
	struct sensor_value full_scale, sampling_freq, oversampling;

	if (dev == NULL) {
		printf("Could not get BMI270 device\n");
		return -1;
	}

	/* Set accelerometer scale, frequency, and mode. */
	full_scale.val1 = 2;       /* 2G scale range */
	full_scale.val2 = 0;
	sampling_freq.val1 = 100;  /* 100Hz frequency */
	sampling_freq.val2 = 0;
	oversampling.val1 = 1;     /* Normal mode */
	oversampling.val2 = 0;

	rc = sensor_attr_set(dev, SENSOR_CHAN_ACCEL_XYZ, SENSOR_ATTR_FULL_SCALE,
			&full_scale);
	if (rc != 0) {
		printf("%s setting accel full_scale failed, rc=%d\n", __func__, rc);
		return rc;
	}
	rc = sensor_attr_set(dev, SENSOR_CHAN_ACCEL_XYZ, SENSOR_ATTR_OVERSAMPLING,
			&oversampling);
	if (rc != 0) {
		printf("%s setting accel oversampling failed, rc=%d\n", __func__, rc);
		return rc;
	}
	rc = sensor_attr_set(dev, SENSOR_CHAN_ACCEL_XYZ,
			SENSOR_ATTR_SAMPLING_FREQUENCY,
			&sampling_freq);
	if (rc != 0) {
		printf("%s setting accel sampling_freq failed, rc=%d\n", __func__, rc);
		return rc;
	}

	/* Set gyroscope scale, frequency, and mode. */
	full_scale.val1 = 500;     /* dps */
	full_scale.val2 = 0;
	sampling_freq.val1 = 100;  /* 100Hz. Performance mode */
	sampling_freq.val2 = 0;
	oversampling.val1 = 1;     /* Normal mode */
	oversampling.val2 = 0;

	rc = sensor_attr_set(dev, SENSOR_CHAN_GYRO_XYZ, SENSOR_ATTR_FULL_SCALE,
			&full_scale);
	if (rc != 0) {
		printf("%s setting gyro full_scale failed, rc=%d\n", __func__, rc);
		return rc;
	}
	rc = sensor_attr_set(dev, SENSOR_CHAN_GYRO_XYZ, SENSOR_ATTR_OVERSAMPLING,
			&oversampling);
	if (rc != 0) {
		printf("%s setting gyro oversampling failed, rc=%d\n", __func__, rc);
		return rc;
	}
	rc = sensor_attr_set(dev, SENSOR_CHAN_GYRO_XYZ,
			SENSOR_ATTR_SAMPLING_FREQUENCY,
			&sampling_freq);
	if (rc != 0) {
		printf("%s setting gyro sampling_freq failed, rc=%d\n", __func__, rc);
		return rc;
	}

	/* Wait for intial samples */
	k_sleep(K_MSEC(100));

	sensor_sample_fetch(dev);

	sensor_channel_get(dev, SENSOR_CHAN_ACCEL_XYZ, acc);
	sensor_channel_get(dev, SENSOR_CHAN_GYRO_XYZ, gyr);

	printf("BMI270 AX: %d.%06d; AY: %d.%06d; AZ: %d.%06d;\n"
	       "       GX: %d.%06d; GY: %d.%06d; GZ: %d.%06d;\n",
		acc[0].val1, acc[0].val2,
		acc[1].val1, acc[1].val2,
		acc[2].val1, acc[2].val2,
		gyr[0].val1, gyr[0].val2,
		gyr[1].val1, gyr[1].val2,
		gyr[2].val1, gyr[2].val2);

	return 0;
}
```
